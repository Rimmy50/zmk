## app/boards/shields/niniergo_split/Kconfig.defconfig
```kconfig
# Copyright (c) 2020 The ZMK Contributors
# SPDX-License-Identifier: MIT

if SHIELD_NINIERGO_SPLIT_LEFT

config ZMK_KEYBOARD_NAME
    default "Niniergo Split"

config ZMK_SPLIT_ROLE_CENTRAL
    default y

endif

if SHIELD_NINIERGO_SPLIT_LEFT || SHIELD_NINIERGO_SPLIT_RIGHT

config ZMK_SPLIT
    default y

endif
```

## app/boards/shields/niniergo_split/Kconfig.shield
```kconfig
# Copyright (c) 2020 The ZMK Contributors
# SPDX-License-Identifier: MIT

config SHIELD_NINIERGO_SPLIT_LEFT
    def_bool $(shields_list_contains,niniergo_split_left)

config SHIELD_NINIERGO_SPLIT_RIGHT
    def_bool $(shields_list_contains,niniergo_split_right)
```

## app/build/niniergo_left/Kconfig/Kconfig.modules
```kconfig
menu "CANopenNode (/Users/nsaroiu/projects/keebs/zmk/modules/lib/canopennode)"
osource "$(ZEPHYR_CANOPENNODE_KCONFIG)"
config ZEPHYR_CANOPENNODE_MODULE
	bool
	default y
endmenu
menu "hal_gigadevice (/Users/nsaroiu/projects/keebs/zmk/modules/hal/gigadevice)"
osource "$(ZEPHYR_HAL_GIGADEVICE_KCONFIG)"
config ZEPHYR_HAL_GIGADEVICE_MODULE
	bool
	default y
endmenu
menu "hal_nordic (/Users/nsaroiu/projects/keebs/zmk/modules/hal/nordic)"
osource "$(ZEPHYR_HAL_NORDIC_KCONFIG)"
config ZEPHYR_HAL_NORDIC_MODULE
	bool
	default y
endmenu
menu "hal_rpi_pico (/Users/nsaroiu/projects/keebs/zmk/modules/hal/rpi_pico)"
osource "$(ZEPHYR_HAL_RPI_PICO_KCONFIG)"
config ZEPHYR_HAL_RPI_PICO_MODULE
	bool
	default y
endmenu
menu "lz4 (/Users/nsaroiu/projects/keebs/zmk/modules/lib/lz4)"
osource "$(ZEPHYR_LZ4_KCONFIG)"
config ZEPHYR_LZ4_MODULE
	bool
	default y
endmenu
menu "mbedtls (/Users/nsaroiu/projects/keebs/zmk/modules/crypto/mbedtls)"
osource "$(ZEPHYR_MBEDTLS_KCONFIG)"
config ZEPHYR_MBEDTLS_MODULE
	bool
	default y
endmenu
menu "nanopb (/Users/nsaroiu/projects/keebs/zmk/modules/lib/nanopb)"
osource "$(ZEPHYR_NANOPB_KCONFIG)"
config ZEPHYR_NANOPB_MODULE
	bool
	default y
endmenu
menu "tflite-micro (/Users/nsaroiu/projects/keebs/zmk/modules/lib/tflite-micro)"
osource "$(ZEPHYR_TFLITE_MICRO_KCONFIG)"
config ZEPHYR_TFLITE_MICRO_MODULE
	bool
	default y
endmenu
menu "TraceRecorder (/Users/nsaroiu/projects/keebs/zmk/modules/debug/TraceRecorder)"
osource "/Users/nsaroiu/projects/keebs/zmk/modules/debug/TraceRecorder/kernelports/Zephyr/Kconfig"
config ZEPHYR_TRACERECORDER_MODULE
	bool
	default y
endmenu
menu "zscilib (/Users/nsaroiu/projects/keebs/zmk/modules/lib/zscilib)"
osource "/Users/nsaroiu/projects/keebs/zmk/modules/lib/zscilib/Kconfig.zscilib"
config ZEPHYR_ZSCILIB_MODULE
	bool
	default y
endmenu
menu "drivers (/Users/nsaroiu/projects/keebs/zmk/app/drivers)"
osource "/Users/nsaroiu/projects/keebs/zmk/app/drivers/Kconfig"
config ZEPHYR_DRIVERS_MODULE
	bool
	default y
endmenu
```

## app/build/right/Kconfig/Kconfig.shield.defconfig
```kconfig
osource "/Users/nsaroiu/projects/keebs/zmk/app/boards/shields/*/Kconfig.defconfig"
```
